// Must change the ~/.arduino15/packages/Simblee/hardware/Simblee/1.1.4/platform.txt file to include 
//    #   {build.path}/syscalls.c.o => {build.path}/syscalls.c.o from
//    #   {build.path}/syscalls.c.o => {build.path}/core/syscalls.c.o
#include <SimbleeRNG.h>
#include <SimbleeAES.h>
#include <SimbleeBLE.h>
#include <SimbleeForMobile.h>
#include <SimbleeForMobileClient.h>
#include <Adafruit_GPS.h>

SimbleeForMobileClient client;


#define GPSSerial Serial
Adafruit_GPS GPS(&GPSSerial);
#define GPSECHO false
#define GPSSDA 5
#define GPSSCL 6

bool started = false;

// private encryption key (generated by the SimbleeRNG generate sketch)
uint8_t key[16] = { 0xc2, 0x20, 0x47, 0xeb, 0x3b, 0xd5, 0x22, 0x71, 0x10, 0x45, 0xb5, 0x13, 0x13, 0x33, 0x74, 0x61 };

// private initialization vector (generated by the SimbleeRNG generate sketch)
uint8_t iv[8] = { 0x7a, 0x91, 0x90, 0xfb, 0xaa, 0xc0, 0x27, 0x0c };

// packet counter (CTR mode combines the IV and pktctr into the full 128-bit nonce)
uint64_t pktctr;

// this must be 0 or 1
uint8_t direction = 1;

// NOTE: the nonce should never be used more than once for a given key or the security can be compromised.

uint8_t msg_in[12 + 1] = "Hello World!";
uint8_t encrypted[12 + 1 + 4];
uint8_t msg_out[12 + 1];

uint32_t timer = millis();

void setup() {
  override_uart_limit = true;
  Serial.begin(115200);

  Serial.println("Starting initilization.");

  // pick a random pktctr (or use a sequential counter and flash memory to pickup where we left off)
  SimbleeRNG::generate((uint8_t*)&pktctr, sizeof(pktctr));  

  // length includes the end-of-string NULL byte
  // (we don't technically need it, but it makes it easier to display the decrypted string later)
  printf("string (length %d): %s\n", sizeof(msg_in), msg_in);

  uint8_t encrypted_len = SimbleeAES::encrypt(key, iv, pktctr, direction, msg_in, sizeof(msg_in), encrypted);

  printf("encrypted stream (length %d): ", encrypted_len);
  for (int i = 0; i < encrypted_len; i++)
    printf("%x ", encrypted[i]);
  printf("\n");
  
  uint8_t msg_out_len = SimbleeAES::decrypt(key, iv, pktctr, direction, encrypted, encrypted_len, msg_out);
  
  printf("decrypted string (length %d): %s\n", msg_out_len, msg_out);

  Serial.println("Adafruit GPS library basic test!");
  startGPS();
  GPS.begin(9600);
  GPS.sendCommand(PMTK_SET_NMEA_OUTPUT_RMCGGA);
  GPS.sendCommand(PMTK_SET_NMEA_UPDATE_1HZ);
  GPS.sendCommand(PGCMD_ANTENNA);
  delay(1000);
  GPSSerial.println(PMTK_Q_RELEASE);
  

  SimbleeForMobile.begin();  
}

void loop() {
  // process must be called in the loop for SimbleeForMobile
  SimbleeForMobile.process();

  startSerial();

  if (started) { 
    if (client.available()) {
      char c = client.read();
      Serial.print(c);
    }

    if (!client.connected()) {
      Serial.println();
      Serial.println("disconnecting.");
      client.stop();
      started = false;
    }
  }
  // read data from the GPS in the 'main loop'
  startGPS();
  char c = GPS.read();
  // if you want to debug, this is a good time to do it!
  if (GPSECHO)
    if (c)
    {
      startSerial();
      Serial.print(c);
    }
  // if a sentence is received, we can check the checksum, parse it...
  if (GPS.newNMEAreceived()) {
    startSerial();
    // a tricky thing here is if we print the NMEA sentence, or data
    // we end up not listening and catching other sentences!
    // so be very wary if using OUTPUT_ALLDATA and trytng to print out data
    Serial.println(GPS.lastNMEA()); // this also sets the newNMEAreceived() flag to false
    if (!GPS.parse(GPS.lastNMEA())) // this also sets the newNMEAreceived() flag to false
      return; // we can fail to parse a sentence in which case we should just wait for another
  }
  // if millis() or timer wraps around, we'll just reset it
  if (timer > millis()) 
    timer = millis();
     
  // approximately every 2 seconds or so, print out the current stats
  if (millis() - timer > 2000) {
    timer = millis(); // reset the timer
    startSerial();
    Serial.print("\nTime: ");
    Serial.print(GPS.hour, DEC); Serial.print(':');
    Serial.print(GPS.minute, DEC); Serial.print(':');
    Serial.print(GPS.seconds, DEC); Serial.print('.');
    Serial.println(GPS.milliseconds);
    Serial.print("Date: ");
    Serial.print(GPS.day, DEC); Serial.print('/');
    Serial.print(GPS.month, DEC); Serial.print("/20");
    Serial.println(GPS.year, DEC);
    Serial.print("Fix: "); Serial.print((int)GPS.fix);
    Serial.print(" quality: "); Serial.println((int)GPS.fixquality);
    if (GPS.fix) {
      Serial.print("Location: ");
      Serial.print(GPS.latitude, 4); Serial.print(GPS.lat);
      Serial.print(", ");
      Serial.print(GPS.longitude, 4); Serial.println(GPS.lon);
      Serial.print("Speed (knots): "); Serial.println(GPS.speed);
      Serial.print("Angle: "); Serial.println(GPS.angle);
      Serial.print("Altitude: "); Serial.println(GPS.altitude);
      Serial.print("Satellites: "); Serial.println((int)GPS.satellites);
    }
  }
}

void ui()
{
  Serial.println("connecting...");

  if (client.connect("www.simblee.com", 443)) {
    Serial.println("connected");
    client.println("GET /webclient.html HTTP/1.1");
    client.println("Host: www.simblee.com");
    client.println("Connection: close");
    client.println();
  } else {
    Serial.println("connection failed");
  }
  
  started = true;
}

void startGPS() {
  Serial.end();

  Serial.begin(9600, GPSSDA, GPSSCL);
}

void startSerial() {
  Serial.end();

  Serial.begin(115200);
}
